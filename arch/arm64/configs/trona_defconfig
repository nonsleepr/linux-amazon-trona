## drivers/misc/mediatek/Kconfig
```kconfig
# SPDX-License-Identifier: GPL-2.0-only
#
# MediaTek's vendor drivers for the connectivity subsystem (CONSYS) built
# into its SoCs. The symbols keep the names the vendor code tests.
#

menuconfig MTK_CONNECTIVITY_VENDOR
	bool "MediaTek vendor connectivity stack (BTIF, WMT, gen3 WiFi)"
	depends on ARCH_MEDIATEK || COMPILE_TEST
	depends on OF && CFG80211
	# The WiFi driver registers private wireless extensions. These change
	# struct net_device and struct iw_handler_def, so they are selected
	# here rather than by the WiFi driver: a kernel configured for this
	# stack then has the same layout whichever of its modules are built.
	select WIRELESS_EXT
	select WEXT_PRIV
	help
	  Support for the WiFi function of the connectivity subsystem found
	  in MediaTek SoCs such as MT8183 (with an MT6631 RF chip), through
	  MediaTek's out-of-tree drivers: the BTIF UART, the WMT core that
	  powers the subsystem up and loads its ROM patches, and the "gen3"
	  cfg80211 WiFi driver.

	  If unsure, say N.

if MTK_CONNECTIVITY_VENDOR

config MTK_BTIF
	tristate "MediaTek BTIF UART for the connectivity subsystem"
	depends on m
	help
	  The UART (with its own two APDMA channels) that the kernel
	  controls the connectivity subsystem over. Needed by the WMT core.

	  The module is called btif.

config MTK_COMBO
	tristate "MediaTek WMT core for the connectivity subsystem"
	depends on MTK_BTIF && m
	depends on PM && NET && GPIOLIB && PINCTRL && REGULATOR
	depends on RESET_CONTROLLER
	select FW_LOADER
	select CRC32
	select ZLIB_DEFLATE
	select MFD_SYSCON
	help
	  The WMT ("wireless management task") core: it powers the
	  connectivity subsystem up and down, loads its ROM patches and
	  carries the WiFi, Bluetooth, FM and GPS functions' control
	  traffic over the STP protocol on BTIF.

	  The module is called wmt_drv.

config MTK_COMBO_CHIP_CONSYS_6771
	def_bool MTK_COMBO
	help
	  The subsystem built into MT6771 and MT8183, with an MT6631 RF
	  chip. The only one this copy of the vendor stack is set up for.

config MTK_WCN_COMBO_CHIP_SUPPORT
	bool "External MT66xx combo chips on SDIO or UART"
	depends on MTK_COMBO && MMC && TTY
	depends on BROKEN
	help
	  The WMT core's support for MediaTek's stand-alone combo chips.
	  Not needed for a subsystem built into the SoC, and not ported
	  to this kernel: it doesn't build.

	  If unsure, say N.

config MTK_COMBO_WIFI
	tristate "MediaTek gen3 WiFi for the connectivity subsystem"
	depends on MTK_COMBO && NL80211_TESTMODE && m
	help
	  MediaTek's "gen3" cfg80211 WiFi driver for the connectivity
	  subsystem, and the adaptor that switches the WiFi function on.

	  The modules are called wlan_drv_gen3 and wmt_chrdev_wifi.

config MTK_COMBO_BT
	tristate "MediaTek STP Bluetooth HCI driver for the connectivity subsystem"
	depends on MTK_COMBO && BT && m
	help
	  Registers a Bluetooth hci_dev with the kernel's Bluetooth core and
	  switches the BT function on through the WMT core, the same way
	  MTK_COMBO_WIFI's wmt_chrdev_wifi switches WiFi on. HCI commands,
	  events, ACL and SCO packets are framed over the WMT core's STP
	  transport, the shared BTIF-based channel the WiFi, FM and GPS
	  functions' control traffic also uses.

	  This replaces mtk_wcn_stpbt_drv_init(), a weak stub in the vendor
	  chip-detection code (common_detect/drv_init/bluetooth_drv_init.c)
	  that was gated on this same symbol name without the symbol, or any
	  real driver behind it, ever existing in this tree.

	  The module is called btmtk_stp.

config AMZN_IDME
	bool "Amazon IDME device data from the device tree"
	depends on MTK_COMBO_WIFI
	default y
	help
	  Amazon's bootloader passes per-device manufacturing data (the
	  board type, the WiFi MAC address and calibration) in an /idme
	  node of the device tree. Say Y for the WiFi driver to use it.

endif # MTK_CONNECTIVITY_VENDOR
```
